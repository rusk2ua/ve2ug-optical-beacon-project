// Q65/Morse Generator for Optical Beacons
// Version 2026.10.08
//
// Original design and sketch (v1.0, 2025): Rene Barbeau VE2UG.
// Revisions 2026.10.08 (NTP sync guard, Wi-Fi timeout, US NTP pool, mode print,
// GPS heartbeat): Rus Healy K2UA.
// See CHANGELOG.md and README.md in the repository root for details.

//GPS.
#include <TinyGPS++.h>
#include <SoftwareSerial.h>
//NTP.
#include <ESP8266WiFi.h>            // we need wifi to get internet access.
#include <time.h>                   // for time() ctime().

// Contributions.

//
// Simple Arduino Morse Beacon
// Written by Mark VandeWettering K6HX
// Email: k6hx@arrl.net
// 
// This code is so trivial that I'm releasing it completely without 
// restrictions.  If you find it useful, it would be nice if you dropped
// me an email, maybe plugged my blog @ https://brainwagon.org or included
// a brief acknowledgement in whatever derivative you create, but that's
// just a courtesy.  Feel free to do whatever.
//

// Informations about GPS and NTP.

/*
   This sample demonstrates TinyGPS++'s capacity for extracting custom
   fields from any NMEA sentence.  TinyGPS++ has built-in facilities for
   extracting latitude, longitude, altitude, etc., from the $GPGLL and
   $GPRMC sentences.  But with the TinyGPSCustom type, you can extract
   other NMEA fields, even from non-standard NMEA sentences.

   It requires the use of SoftwareSerial, and assumes that you have a
   9600-baud serial GPS device TXD connected on pin D7(RX), and RXD on pin D6(TX).
*/

/*
  NTP TZ DST - bare minimum
  NetWork Time Protocol - Time Zone - Daylight Saving Time

  Our target for this MINI sketch is:
  - get the SNTP request running
  - set the timezone
  - (implicit) respect daylight saving time
  - how to "read" time to be printed to Serial.Monitor
  
  This example is a stripped down version of the NTP-TZ-DST (v2)
  And works for ESP8266 core 2.7.4 and 3.0.2

  by noiasca
  2020-09-22 see https://werner.rothschopf.net/202011_arduino_esp8266_ntp_en.htm
*/






// CONFIGURATION LIST.  *********************************************************

// Global setting.

int OutPin= D8;                 // Output Pin of WEMOS D1 mini.
                                // NOTE: D8 (GPIO15) is a boot strapping pin. It must be LOW at
                                // boot, so don't let your output circuit pull it HIGH at power-up.
int ModePin = D5;               // Input pin to select GPS/NTP mode. GPIO 14 is Pin D5.
int ModePinState = 1;           // State of ModePin. Either 0 (grounded) or 1 (open).
                                // NTP selected When grounded.
                                // GPS selected when open.
int ModeSelected = 1;           // Mode chosen in Setup routine. GPS by default.

// GPS Configuration.

static const uint32_t GPSBaud = 9600;   // 9600 bps for NEO-xM family of GPS.


// NTP Configuration.

time_t now;                         // this are the seconds since Epoch (1970) - UTC.
tm tm;                              // the structure tm holds time information in a more convenient way.

#ifndef STASSID
#define STASSID "redacted"            // set your SSID.
#define STAPSK  "redacted"        // set your wifi password.
#endif

#define MY_NTP_SERVER "us.pool.ntp.org"  // NTP server pool (US pool for lower latency from New York).
#define MY_TZ "EST5EDT,M3.2.0,M11.1.0"   // Eastern Standard Time with Daylight Saving; 2nd March, November 1st.

#define WIFI_TIMEOUT_MS  20000UL         // How long to wait for Wi-Fi in setup() before reporting an error.
#define NTP_VALID_AFTER  1700000000UL    // Any epoch time before this means SNTP has not set the clock yet.

bool ClockSynced = false;                // Set true once NTP has set the clock (NTP mode).




// Q65 Configuration.

// Use q65code.exe to generate your message. Add commas between numbers and place into this Array[].
// This message is:  K2UA FN12FR


int CarrierFreq = 14000;            // Carrier frequency in Hz when in subcarrier mode. Can be changed.
                                    // Maximum tone that can be generated by tone() is 20 KHz,
                                    // including the CarrierFreq, BaseFreq and maximum tone frequency.
                                    // 16 KHz as maximum CarrierFreq is a safe bet.
int BaseFreq = 1000;                // Hz over carrier frequency, can be changed.
float  SymbolLength = 0.300;        // Symbol length in second. For Q65-30.
float ToneSpacing = 3.33;           // Tone spacing in Hz. Q65 Mode A is 3.33, Mode B is 6.67.
                                    // Mode C is 13.33, Mode D is 26.67.
int Start = 0;                      // Start time of Q65 message. (0 = First, 30 = 2nd).


int Q65[85] = {
  0,  1,  1, 40, 64, 28,  8, 53,  0, 31,  8,  0,  0,  8,  0, 50, 49,  1,  4,  4,
 61,  0,  0, 40, 18,  0,  0, 18, 23, 47, 58, 28,  0, 28,  0,  6,  6,  0, 41, 11,
 58, 58, 34, 30, 45,  0, 50, 55, 39,  0, 54, 54, 59, 42,  0, 42, 42, 26, 63,  0,
 29,  0, 25, 62, 10,  0, 26, 56,  0, 56, 60, 13, 27,  0, 27,  0, 21,  1, 46, 18,
 23,  8,  5, 41,  0 };



// Morse Configuration.

#define SPEED  (18)                   // Morse code speed in WPM. Change to suit your need.

char CWMessage[] = "K2UA FN12FR ";   // CW message. LEAVE A SPACE AT THE END. 
                                      // Keep it short, or increase CW speed to keep whole sequence under 60 seconds.


// Carrier Configuration.

int CarrierLength = 10;               // Length of carrier in seconds. Be careful to keep whole sequence under 60 seconds.



// END OF CONFIGURATION LIST.  *********************************************************





// GPS settings.

static const int RXPin = D7, TXPin = D6;

// TinyGPS++ object.
TinyGPSPlus gps;

// Software serial connection to the GPS device.
SoftwareSerial ss(RXPin, TXPin);

//Second timing vartiable.

int CurrentSecond = 0;     // Set a default value to the Second field.

unsigned long LastHeartbeat = 0;   // millis() of the last GPS heartbeat print.

// End of GPS settings.


// NTP Section.

// Time routine.

void showTime() {
  time(&now);                       // read the current time
  localtime_r(&now, &tm);           // update the structure tm with the current time
  }




// Q65 beacon section.

int Q65_Array = 85;             // Q65 Message Lenght. Fixed
int Q65TonesFreq [85];          // Q65 Message translated into frequencies to generate with Tone().



// Q65 beacon routine.

void Q65SendMsg () {
  digitalWrite(LED_BUILTIN, LOW) ;            // Activate LED to show tone activity.
  for (int ToneNumber = 0; ToneNumber < 85; ToneNumber++) { 
    Q65TonesFreq[ToneNumber] = CarrierFreq + BaseFreq + Q65[ToneNumber]*ToneSpacing;  // Translate Q65 message from Q65code.exe into frequencies.
    tone(OutPin, Q65TonesFreq[ToneNumber] );
    delay(SymbolLength*1000);
    noTone(OutPin);
    //Serial.print( Q65TonesFreq[ToneNumber]);                     // Uncomment if you want to see the tone frequencies on terminal.
    //Serial.print(", ");                                          // Uncomment if you want to see the tone frequencies on terminal.
    }
  digitalWrite(LED_BUILTIN, HIGH) ;           // End of tone activity.
}



// Morse keyer section.

int CWTone = CarrierFreq + BaseFreq;  // Subcarrier mode.

struct t_mtab { char c, pat; } ;

struct t_mtab morsetab[] = {
    {'.', 106},
  {',', 115},
  {'?', 76},
  {'/', 41},
  {'A', 6},
  {'B', 17},
  {'C', 21},
  {'D', 9},
  {'E', 2},
  {'F', 20},
  {'G', 11},
  {'H', 16},
  {'I', 4},
  {'J', 30},
  {'K', 13},
  {'L', 18},
  {'M', 7},
  {'N', 5},
  {'O', 15},
  {'P', 22},
  {'Q', 27},
  {'R', 10},
  {'S', 8},
  {'T', 3},
  {'U', 12},
  {'V', 24},
  {'W', 14},
  {'X', 25},
  {'Y', 29},
  {'Z', 19},
  {'1', 62},
  {'2', 60},
  {'3', 56},
  {'4', 48},
  {'5', 32},
  {'6', 33},
  {'7', 35},
  {'8', 39},
  {'9', 47},
  {'0', 63}
} ;

#define N_MORSE  (sizeof(morsetab)/sizeof(morsetab[0]))
#define DOTLEN  (1200/SPEED)
#define DASHLEN  (3*(1200/SPEED))


// Morse keyer routines.

void
dash() {
  digitalWrite(LED_BUILTIN, LOW) ;
  tone(OutPin, CWTone);
  delay(DASHLEN);
  digitalWrite(LED_BUILTIN, HIGH) ;
  noTone(OutPin);
  delay(DOTLEN) ;
}

void
dit() {
  digitalWrite(LED_BUILTIN, LOW) ;
  tone(OutPin, CWTone);
  delay(DOTLEN);
  digitalWrite(LED_BUILTIN, HIGH) ;
  noTone(OutPin);
  delay(DOTLEN);
}

void
send(char c)
{
  int i ;
  if (c == ' ') {
    Serial.print(c) ;
    delay(7*DOTLEN) ;
    return ;
  }
  for (i=0; i<N_MORSE; i++) {
    if (morsetab[i].c == c) {
      unsigned char p = morsetab[i].pat ;
      Serial.print(morsetab[i].c) ;

      while (p != 1) {
          if (p & 1)
            dash() ;
          else
            dit() ;
          p = p / 2 ;
      }
      delay(2*DOTLEN) ;
      return ;
    }
  }
  /* if we drop off the end, then we send a space */
  Serial.print("?") ;
}

void
sendmsg(char *str)
{
  while (*str)
    send(*str++) ;
}


// Carrier section.

// Carrier routine.

void Carrier() {
  delay(500) ;                             // 500ms delay.
  Serial.println("\nStart of Carrier");                          
  digitalWrite(LED_BUILTIN, LOW) ;         // Start of carrier.
  tone(OutPin, CWTone );
  delay(CarrierLength*1000);               // Carrier length in milliseconds.
  digitalWrite(LED_BUILTIN, HIGH) ;
  noTone(OutPin);                          // Carrier stopped.
}






void setup()
{
//ModePin Setup.
pinMode(ModePin, INPUT_PULLUP);       // ModePin to select GPS or NTP.

//LED setup.
pinMode(LED_BUILTIN, OUTPUT);         // LED_BUILTIN is inverted! 
digitalWrite(LED_BUILTIN, HIGH) ;     // LED off.

//Q65 Setup.
pinMode(OutPin, OUTPUT);

//Serial port.
Serial.begin(9600);                        // Serial ports configuration.
                                           // (The ESP8266 boot banner is 74880; set the monitor to 9600 to read this sketch's output.)

//Test of mode, NTP or GPS.
ModePinState = digitalRead(ModePin);       // Read the state of the Modepin.
if (ModePinState == 0) {
      ModeSelected = 0;                    // NTP Mode if ModePin grounded.
      //NTP Configuration.
      Serial.println("\nNTP TZ DST - bare minimum");
      configTime(MY_TZ, MY_NTP_SERVER);    // --> Here is the IMPORTANT ONE LINER needed in your sketch!

      // start network.
      WiFi.persistent(false);
      WiFi.mode(WIFI_STA);
      WiFi.begin(STASSID, STAPSK);

      unsigned long wifiStart = millis();
      while (WiFi.status() != WL_CONNECTED && (millis() - wifiStart) < WIFI_TIMEOUT_MS) {
        delay(200);
        Serial.print ( "." );
      }

      if (WiFi.status() == WL_CONNECTED) {
        Serial.println("\nWiFi connected");
      }
      else {
        // Not fatal: the ESP8266 keeps trying to connect in the background, and
        // loop() will not transmit until NTP has actually set the clock.
        Serial.println("\nWiFi FAILED after timeout - check SSID, password and signal. Still retrying in background.");
      }
      }
      else {
        ModeSelected = 1;                // GPS Mode if ModePin open.
        ss.begin(GPSBaud);
      }

Serial.println(ModeSelected ? "GPS mode" : "NTP mode");   // Show which branch we landed in.
}


void loop()  
{
if (ModeSelected == 0) {                 // NTP Mode.                           
    noTone(OutPin);
    showTime();
    time(&now);                         // read the current time.
    localtime_r(&now, &tm);             // update the structure tm with the current time.

    // Don't transmit until SNTP has actually set the clock (otherwise time() is ~1970).
    if (now < (time_t)NTP_VALID_AFTER) {
      return;
    }
    if (!ClockSynced) {
      ClockSynced = true;
      Serial.println("\nNTP clock synced");
    }

    if (tm.tm_sec == Start) {
      Serial.println("\nStart of transmission");
      Q65SendMsg();                     // Q65 message.
      delay(1000);                      // Some rest before loop.
      sendmsg(CWMessage) ;              // Morse message.
      Carrier();                        // Carrier.
      Serial.println("End of transmission");
      }  
  }
  else  {                               // GPS Mode.
      while (ss.available() > 0)
      gps.encode(ss.read());

      // Heartbeat once a second: 0 chars = no GPS data at all (wiring/power),
      // climbing count with valid=0 = data flowing but no fix/time yet.
      if (millis() - LastHeartbeat >= 1000) {
        LastHeartbeat = millis();
        Serial.print(F("GPS chars processed: "));
        Serial.print(gps.charsProcessed());
        Serial.print(F("  time valid: "));
        Serial.println(gps.time.isValid() ? F("yes") : F("no"));
      }

      if (gps.time.isValid()) {

        if (gps.time.second() != CurrentSecond ) {
          CurrentSecond = gps.time.second();
          if (gps.time.second() < 10) {
            Serial.print(F("0"));              // We send the current second on USB the serial port for troubleshooting.
            Serial.print(gps.time.second());
            Serial.print(F("."));
            }
            else {
              Serial.print(gps.time.second());
              Serial.print(F("."));
            }
         Serial.println();
         if ( CurrentSecond == Start ) {    // Triggerpoint to start Q65 sequence.
           Serial.print("Start of transmission ");
           Serial.println();
           ss.end();                         // We disable the software serial port to prevent tone() jitter.
           Q65SendMsg();                     // Q65 message.
           delay(1000);                      // Some rest before loop.
           sendmsg(CWMessage) ;              // Morse message.
           Carrier();                        // Carrier.
           ss.begin(GPSBaud);                // We reactivate the software serial port to listen to the GPS datastream.
         }    
        }     
      } 
  }
}
